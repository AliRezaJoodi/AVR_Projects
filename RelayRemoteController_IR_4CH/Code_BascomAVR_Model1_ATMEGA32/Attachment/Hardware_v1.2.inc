 
Config Rc5 = Pind.2

Config PortA.1 = Output : PortA.1 = 0 : Relay1 Alias PortA.1
Config PortA.2 = Output : PortA.2 = 0 : Relay2 Alias PortA.2
Config PortA.3 = Output : PortA.3 = 0 : Relay3 Alias PortA.3
Config PortA.4 = Output : PortA.4 = 0 : Relay4 Alias Portb.4
Config PortA.5 = Output : PortA.5 = 0 : Relay_enable Alias PortA.5

Config Portd.7 = Output : Portd.7 = 0 : Led_IR Alias Portd.7

Config PortC.0 = Input : PortC.0 = 1 : Jumper_address Alias PinC.0
Config PortC.1 = Input : PortC.1 = 1 : Jumper_command Alias PinC.1
Config Portc.2 = Input : Portc.2 = 1 : Jumper_Relay1 Alias Pinc.2
Config Portc.3 = Input : Portc.3 = 1 : Jumper_Relay2 Alias Pinc.3
Config Portc.4 = Input : Portc.4 = 1 : Jumper_Relay3 Alias Pinc.4
Config Portc.5 = Input : Portc.5 = 1 : Jumper_Relay4 Alias Pinc.5

