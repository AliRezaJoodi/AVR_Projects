Config Rc5 = Pind.2

Config Portc.1 = Output : Portc.1 = 0 : Relay1 Alias Portc.1
Config Portc.2 = Output : Portc.2 = 0 : Relay2 Alias Portc.2
Config Portb.1 = Output : Portb.1 = 0 : Relay3 Alias Portb.1
Config Portb.2 = Output : Portb.2 = 0 : Relay4 Alias Portb.2
Config Portb.0 = Output : Portb.0 = 0 : Relay_enable Alias Portb.0

Config Portd.4 = Output : Portd.4 = 0 : Led_IR Alias Portd.4

Config PortC.0 = Input : PortC.0 = 1 : Jumper_address Alias PinC.0
Config PortC.3 = Input : PortC.3 = 1 : Jumper_command Alias PinC.3
Config Portc.4 = Input : Portc.4 = 1 : Jumper_Relay1 Alias Pinc.4
Config Portc.5 = Input : Portc.5 = 1 : Jumper_Relay2 Alias Pinc.5
Config PortD.5 = Input : PortD.5 = 1 : Jumper_Relay3 Alias PinD.5
Config PortD.6 = Input : PortD.6 = 1 : Jumper_Relay4 Alias PinD.6


