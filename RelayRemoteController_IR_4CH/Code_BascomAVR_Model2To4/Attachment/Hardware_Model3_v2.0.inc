Config Rc5 = Pind.2

Config Portd.4 = Output : Portd.4 = 0 : Relay1 Alias Portd.4
Config Portd.5 = Output : Portd.5 = 0 : Relay2 Alias Portd.5
Config Portd.6 = Output : Portd.6 = 0 : Relay3 Alias Portd.6
Config Portd.7 = Output : Portd.7 = 0 : Relay4 Alias Portd.7

Config Portb.0 = Output : Portb.0 = 0 : Relay_enable Alias Portb.0

Config Portc.4 = Output : PortC.4 = 0 : Led_IR Alias PortC.4

Config PortB.1 = Input : PortB.1 = 1 : Jumper_address Alias PinB.1
Config PortB.2 = Input : PortB.2 = 1 : Jumper_command Alias PinB.2
Config Portc.3 = Input : Portc.3 = 1 : Jumper_Relay1 Alias Pinc.3
Config Portc.2 = Input : Portc.2 = 1 : Jumper_Relay2 Alias Pinc.2
Config Portc.1 = Input : Portc.1 = 1 : Jumper_Relay3 Alias Pinc.1
Config Portc.0 = Input : Portc.0 = 1 : Jumper_Relay4 Alias Pinc.0


