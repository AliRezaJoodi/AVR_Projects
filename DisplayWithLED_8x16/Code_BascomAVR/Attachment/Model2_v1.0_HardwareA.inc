
Config Porta.0 = Output : Porta.0 = 0 : Data1_0 Alias Portc.7
Config Porta.1 = Output : Porta.1 = 0 : Data1_1 Alias Porta.0
Config Porta.2 = Output : Porta.2 = 0 : Data1_2 Alias Porta.1
Config Porta.3 = Output : Porta.3 = 0 : Data1_3 Alias Porta.6
Config Porta.4 = Output : Porta.4 = 0 : Data1_4 Alias Porta.2
Config Porta.5 = Output : Porta.5 = 0 : Data1_5 Alias Porta.7
Config Porta.6 = Output : Porta.6 = 0 : Data1_6 Alias Portc.5
Config Porta.7 = Output : Porta.7 = 0 : Data1_7 Alias Portc.6

Config Portc.0 = Output : Portc.0 = 0 : Data2_0 Alias Portc.2
Config Portc.1 = Output : Portc.1 = 0 : Data2_1 Alias Porta.5
Config Portc.2 = Output : Portc.2 = 0 : Data2_2 Alias Porta.4
Config Portc.3 = Output : Portc.3 = 0 : Data2_3 Alias Portc.0
Config Portc.4 = Output : Portc.4 = 0 : Data2_4 Alias Porta.3
Config Portc.5 = Output : Portc.5 = 0 : Data2_5 Alias Portc.1
Config Portc.6 = Output : Portc.6 = 0 : Data2_6 Alias Portc.3
Config Portc.7 = Output : Portc.7 = 0 : Data2_7 Alias Portc.4

Config Portb.0 = Output : Portb.0 = 0 : Column_a Alias Portb.3
Config Portb.1 = Output : Portb.1 = 0 : Column_b Alias Portb.0
Config Portb.2 = Output : Portb.2 = 0 : Column_c Alias Portb.4
Config Portb.3 = Output : Portb.3 = 0 : Column_d Alias Portb.1
Config Portb.4 = Output : Portb.4 = 0 : Column_e Alias Portb.6
Config Portb.5 = Output : Portb.5 = 0 : Column_f Alias Portb.5
Config Portb.6 = Output : Portb.6 = 0 : Column_g Alias Portb.7
Config Portb.7 = Output : Portb.7 = 0 : Column_h Alias Portb.2