IR_PIN Alias Pind.2

Config Portc.1 = Output : Portc.1 = 0 : Relay1 Alias Portc.1
Config Portc.0 = Output : Portc.0 = 0 : Relay2 Alias Portc.0
Config Portb.5 = Output : Portb.5 = 0 : Relay3 Alias Portb.5
Config Portb.4 = Output : Portb.4 = 0 : Relay4 Alias Portb.4

Config Portb.1 = Output : Portb.1 = 0 : Relay_enable Alias Portb.1

Config Portd.4 = Output : Portd.4 = 0 : Led_IR Alias Portd.4

Config Portd.0 = Input : Portd.0 = 1 : Jumper_address Alias Pind.0
Config Portd.1 = Input : Portd.1 = 1 : Jumper_command Alias Pind.1

Config Portc.5 = Input : Portc.5 = 1 : Jumper_Relay1 Alias Pinc.5
Config Portc.4 = Input : Portc.4 = 1 : Jumper_Relay2 Alias Pinc.4
Config Portc.3 = Input : Portc.3 = 1 : Jumper_Relay3 Alias Pinc.3
Config Portc.2 = Input : Portc.2 = 1 : Jumper_Relay4 Alias Pinc.2

