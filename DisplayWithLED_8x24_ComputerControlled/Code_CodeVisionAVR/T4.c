#include <mega8.h>
#include <delay.h>
#include <stdio.h>
#include <string.h>
#include <ctype.h>

#define CHKBIT(ADDRESS,BIT)  (ADDRESS &(1<<BIT))
#define   columns   24

#define Data_0  PORTD.7
#define Data_1  PORTD.6
#define Data_2  PORTD.5
#define Data_3  PORTB.7
#define Data_4  PORTB.6
#define Data_5  PORTD.4
#define Data_6  PORTD.3
#define Data_7  PORTD.2

#define Column_a  PORTC.4
#define Column_b  PORTC.5
#define Column_c  PORTC.3
#define Column_d  PORTC.2
#define Column_e  PORTC.1
#define Column_f  PORTC.0
#define Column_g  PORTB.5
#define Column_h  PORTB.4

#define Matrix_1  PORTB.1
#define Matrix_2  PORTB.2
#define Matrix_3  PORTB.3

void Decode_data(void);
void Erase_data(void);

const char font[] = { 
 0x00 , 0x00 , 0x00 , 0x00 , 0x00 , 0x00 , 0x00 , 0x00 ,
 0x00 , 0x00 , 0x00 , 0x00 , 0x00 , 0x00 , 0x00 , 0x00 ,
 0x00 , 0x00 , 0x00 , 0x00 , 0x00 , 0x00 , 0x00 , 0x00 ,
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 0x40 , 0xC0 , 0x80 , 0xC0 , 0x40 , 0xC0 , 0x80 , 0x00 ,//~
};

char Text[30]="www.M32.ir";
unsigned char dat[700];
unsigned char z;    
unsigned char Text_length=0; 
    unsigned int k1 = 0;
    unsigned int k2 = 0;
    unsigned int k3 = 0;
    unsigned char Segment=0;
    unsigned int Scan = 0; 
    
void main(void)
{
    unsigned int s = 0;
    unsigned int e = 0;
    unsigned char Refresh=0;
    unsigned char Spead=3;
    unsigned int i = 0;
    unsigned int b = 0;
    unsigned int d = 0;
    unsigned char dd;
// USART initialization
// Communication Parameters: 8 Data, 1 Stop, No Parity
// USART Receiver: Off
// USART Transmitter: On
// USART Mode: Asynchronous
// USART Baud Rate: 9600
UCSRA=0x00;
UCSRB=0x08;
UCSRC=0x86;
UBRRH=0x00;
UBRRL=0x33;
    DDRB=0xFF; PORTB=0x00;
    DDRC=0x7F; PORTC=0x00;
    DDRD=0xFC; PORTD=0x00;
    Erase_data();
    Decode_data();             
    while(1)
	{  
        for(s=0;s<=z;s++)
        {
            e=s+7;
            for(Refresh=1;Refresh<=Spead;Refresh++)
            {
                Scan=0b00000001;
                for(i=s;i<=e;i++)
                {
                    Segment=0b00000001;
                    for(b=0;b<3;b++)
                    {
                        d=(b*8)+i;
                        dd=dat[d];
                        Data_7=CHKBIT(dd,0);Data_6=CHKBIT(dd,1);Data_5=CHKBIT(dd,2);Data_4=CHKBIT(dd,3);Data_3=CHKBIT(dd,4);Data_2=CHKBIT(dd,5);Data_1=CHKBIT(dd,6);Data_0=CHKBIT(dd,7);
                        Matrix_1=CHKBIT(Segment,0);Matrix_2=CHKBIT(Segment,1);Matrix_3=CHKBIT(Segment,2);
                        Segment=Segment<<1;
                        delay_us(1);Matrix_1=0;Matrix_2=0;Matrix_3=0; 
                    }
                    Column_h=1;
                    Column_a=CHKBIT(Scan,0); Column_b=CHKBIT(Scan,1); Column_c=CHKBIT(Scan,2); Column_d=CHKBIT(Scan,3); Column_e=CHKBIT(Scan,4); Column_f=CHKBIT(Scan,5); Column_g=CHKBIT(Scan,6); Column_h=CHKBIT(Scan,7); 
                    Scan=Scan<<1;
                    delay_ms(2);
                    Column_a=0; Column_b=0; Column_c=0; Column_d=0; Column_e=0; Column_f=0; Column_g=0; Column_h=0;
                }    
            }    
        };
	}            
} 

void Decode_data(void)
{
    unsigned int Data_number = columns;
    char Character = 0;
    unsigned int Character_ascii = 0; 
    unsigned char j=0;
    Text_length=strlen(Text);
    z=((columns/8)+Text_length)*8;
    for (j=0;j<Text_length;j++) 
    {
        Character=Text[j];
        Character_ascii=toascii(Character);
        k1=(Character_ascii-30)*8;
        k2=k1+7;
        for(k3=k1;k3<=(k1+7);k3++)
        {
            dat[Data_number]=font[k3];
            Data_number=Data_number+1;
        };   
    };
}

void Erase_data(void)
{
    unsigned int i=0;
    for (i=1;i<701;i++) { dat[i]=0; };
}
